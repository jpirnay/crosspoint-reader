## sdkconfig.defaults
```kconfig
# Bluetooth Controller Configuration for ESP32-C3
CONFIG_BT_ENABLED=y
CONFIG_BT_NIMBLE_ENABLED=y
CONFIG_BTDM_CTRL_MODE_BLE_ONLY=y
CONFIG_BT_CONTROLLER_ENABLED=y

# NimBLE Memory Optimization
CONFIG_BT_NIMBLE_MAX_CONNECTIONS=1
CONFIG_BT_NIMBLE_TASK_STACK_SIZE=4608
CONFIG_BT_NIMBLE_LOG_LEVEL=0
CONFIG_BT_NIMBLE_MAX_DEVICE_NAME_LEN=16
CONFIG_BT_NIMBLE_MAX_EXT_ADV_INSTANCES=1
CONFIG_BT_NIMBLE_ATT_PREFERRED_MTU=256
CONFIG_BT_NIMBLE_MAX_SERVICES=8

# Enable Bluetooth in Arduino framework
CONFIG_ARDUINO_BT_ENABLED=y
```
